## sdkconfig.defaults
```kconfig
# ===================== 目标芯片 / 存储 =====================
CONFIG_IDF_TARGET="esp32s31"
CONFIG_ESPTOOLPY_FLASHSIZE_16MB=y
CONFIG_ESPTOOLPY_FLASHSIZE="16MB"

# ===================== PSRAM (N16R16: 8 线 PSRAM) =====================
CONFIG_SPIRAM=y
CONFIG_SPIRAM_MODE_OCT=y
CONFIG_SPIRAM_SPEED_200M=y
CONFIG_SPIRAM_USE_MALLOC=y
CONFIG_SPIRAM_MALLOC_ALWAYSINTERNAL=16384
CONFIG_SPIRAM_TRY_ALLOCATE_WIFI_LWIP=y
CONFIG_SPIRAM_MALLOC_RESERVE_INTERNAL=32768

# ===================== 分区表 =====================
CONFIG_PARTITION_TABLE_CUSTOM=y
CONFIG_PARTITION_TABLE_CUSTOM_FILENAME="partitions.csv"
CONFIG_BOOTLOADER_APP_ROLLBACK_ENABLE=y
CONFIG_ESP_CONSOLE_SECONDARY_NONE=y

# ===================== 系统 =====================
CONFIG_FREERTOS_HZ=1000
CONFIG_ESP_MAIN_TASK_STACK_SIZE=8192
CONFIG_ESP_SYSTEM_EVENT_TASK_STACK_SIZE=4096
# GCC 15 的 stringop-truncation 会在 IDF 自带的 bluedroid 里报 -Werror，官方开关关掉
CONFIG_COMPILER_DISABLE_GCC15_WARNINGS=y

# ===================== FATFS / VFS =====================
CONFIG_FATFS_LFN_HEAP=y
CONFIG_FATFS_MAX_LFN=255
CONFIG_FATFS_API_ENCODING_UTF_8=y
CONFIG_FATFS_CODEPAGE_936=y
CONFIG_FATFS_VOLUME_COUNT=2
CONFIG_VFS_MAX_COUNT=16

# ===================== 经典蓝牙 / A2DP / AVRCP =====================
CONFIG_BT_ENABLED=y
CONFIG_BTDM_CTRL_MODE_BR_EDR_ONLY=y
CONFIG_BT_BLUEDROID_ENABLED=y
CONFIG_BT_CLASSIC_ENABLED=y
CONFIG_BT_A2DP_ENABLE=y
CONFIG_BT_AVRCP_ENABLED=y
CONFIG_BT_SPP_ENABLED=y
CONFIG_BT_SSP_ENABLED=y
CONFIG_BT_BLE_ENABLED=n
# A2DP source 需要较大的发送缓冲
CONFIG_BT_A2DP_QUEUE_LEN=32
CONFIG_BT_BTC_TASK_STACK_SIZE=4096
CONFIG_BT_BTU_TASK_STACK_SIZE=4608

# ===================== Wi-Fi AP（预留：手机传歌） =====================
CONFIG_ESP_WIFI_STATIC_RX_BUFFER_NUM=8
CONFIG_ESP_WIFI_DYNAMIC_RX_BUFFER_NUM=16

# ===================== 编译器 =====================
CONFIG_COMPILER_OPTIMIZATION_PERF=y
CONFIG_COMPILER_WARN_WRITE_STRINGS=n

# A2DP Source: external AAC-LC and SBC encoders, with SBC fallback.
CONFIG_BT_A2DP_USE_EXTERNAL_CODEC=y
CONFIG_BT_A2DP_CODEC_AAC_ENABLED=y
CONFIG_BT_A2DP_SEP_NUM_MAX=2
```
